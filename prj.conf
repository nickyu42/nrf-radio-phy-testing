## CMakeLists.txt
```
cmake_minimum_required(VERSION 3.20.0)

find_package(Zephyr REQUIRED HINTS $ENV{ZEPHYR_BASE})
project(NONE)

FILE(GLOB app_sources src/*.c)

target_sources(app PRIVATE
  ${app_sources}
)
```

## prj.conf
```kconfig
CONFIG_DYNAMIC_INTERRUPTS=y

CONFIG_NRFX_TIMER0=y

# For logging data
CONFIG_FLASH=y

# RTT
CONFIG_UART_CONSOLE=n
CONFIG_USE_SEGGER_RTT=y
CONFIG_RTT_CONSOLE=y

# Bluetooth
CONFIG_BT=y
CONFIG_BT_DEBUG_LOG=y
CONFIG_BT_SMP=y
CONFIG_BT_PERIPHERAL=y
CONFIG_BT_DEVICE_NAME="platynode"
CONFIG_BT_DIS=y
CONFIG_BT_DIS_PNP=n

# Bigger bluetooth MTU
# CONFIG_BT_BUF_ACL_RX_SIZE=251
# CONFIG_BT_ATT_PREPARE_COUNT=2
# CONFIG_BT_CONN_TX_MAX=10
# CONFIG_BT_L2CAP_TX_BUF_COUNT=10
# CONFIG_BT_L2CAP_TX_MTU=247
# CONFIG_BT_BUF_ACL_RX_SIZE=251
# CONFIG_BT_L2CAP_DYNAMIC_CHANNEL=y

# CONFIG_MPSL_ASSERT_HANDLER=y

# BLE coded PHY
# CONFIG_BT_CTLR_PHY_CODED=y
# CONFIG_BT_CTLR_ADV_EXT=y

# CONFIG_BT_EXT_ADV=y
# CONFIG_BT_USER_PHY_UPDATE=y

# Necessary for disabling MPSL
CONFIG_MPSL=y
# CONFIG_DYNAMIC_DIRECT_INTERRUPTS=y
# CONFIG_MPSL_DYNAMIC_INTERRUPTS=y
CONFIG_MPSL_TIMESLOT_SESSION_COUNT=1

# Debugging
CONFIG_DEBUG_OPTIMIZATIONS=y
CONFIG_DEBUG_INFO=y
CONFIG_DEBUG_THREAD_INFO=y
# CONFIG_CORTEX_M_DEBUG_MONITOR_HOOK=y
# CONFIG_SEGGER_DEBUGMON=y
```

## src/main.c
```c
#include <zephyr/sys/printk.h>
#include <zephyr/drivers/clock_control.h>
#include <zephyr/drivers/clock_control/nrf_clock_control.h>
#include <zephyr/drivers/flash.h>
#include <zephyr/drivers/gpio.h>

#include "radio.h"
#include "bluetooth.h"
#include "service.h"
#include "timer.h"
#include "timeslot.h"

#define STATUS_THREAD_STACKSIZE 256
#define STATUS_THREAD_PRIORITY 7

#define LED0_NODE DT_ALIAS(led0)
#define LED1_NODE DT_ALIAS(led1)

static const struct gpio_dt_spec led0 = GPIO_DT_SPEC_GET(LED0_NODE, gpios);
static const struct gpio_dt_spec led1 = GPIO_DT_SPEC_GET(LED1_NODE, gpios);

static void clock_init(void)
{
	printk("clock_init: Starting High Frequency Clock\n");
	int err;
	int res;
	struct onoff_manager *clk_mgr;
	struct onoff_client clk_cli;

	clk_mgr = z_nrf_clock_control_get_onoff(CLOCK_CONTROL_NRF_SUBSYS_HF);
	if (!clk_mgr)
	{
		printk("clock_init: Unable to get the Clock manager\n");
		return;
	}

	sys_notify_init_spinwait(&clk_cli.notify);

	err = onoff_request(clk_mgr, &clk_cli);
	if (err < 0)
	{
		printk("clock_init: Clock request failed: %d\n", err);
		return;
	}

	do
	{
		err = sys_notify_fetch_result(&clk_cli.notify, &res);
		if (!err && res)
		{
			printk("Clock could not be started: %d\n", res);
			return;
		}
	} while (err);

	printk("clock_init: Clock has started\n");
}

void status_led_thread(void)
{
	if (!gpio_is_ready_dt(&led0) || !gpio_is_ready_dt(&led1))
	{
		printk("status_led_thread: Could not enable status LEDs\n");
		return;
	}

	if (gpio_pin_configure_dt(&led0, GPIO_OUTPUT_ACTIVE) < 0 || gpio_pin_configure_dt(&led1, GPIO_OUTPUT_ACTIVE) < 0)
	{
		printk("status_led_thread: Could not configure status LEDs\n");
		return;
	}

	// Turn LEDs off initially
	gpio_pin_set_dt(&led0, 0);
	gpio_pin_set_dt(&led1, 0);

	uint8_t ctr = 0;
	uint8_t heartbeat_ctr = 0;

	while (true)
	{
		if (radio_is_active_counter > 0 && ctr >= 50)
		{
			gpio_pin_toggle_dt(&led0);
			ctr = 0;
		}

		if (radio_is_active_counter > 0)
		{
			ctr++;
			radio_is_active_counter -= 10;
		}

		if (radio_is_active_counter == 10)
		{
			gpio_pin_set_dt(&led0, 0);
		}

		heartbeat_ctr++;
		if (heartbeat_ctr >= 80)
		{
			gpio_pin_toggle_dt(&led1);
			heartbeat_ctr = 0;
		}

		k_msleep(10);
	}
}

int main(void)
{
	clock_init();
	// bluetooth_init();

	timer_init();
	timer_connect_to_gpiote();

	start_radio_timeslot();

	printk("main: Init done\n");
	return 0;
}

K_THREAD_DEFINE(status_led_thread_id, STATUS_THREAD_STACKSIZE, status_led_thread, NULL, NULL, NULL,
				STATUS_THREAD_PRIORITY, 0, 0);
```

## src/bluetooth.c
```c
#include <zephyr/sys/printk.h>

#include <zephyr/bluetooth/bluetooth.h>
#include <zephyr/bluetooth/conn.h>
#include <zephyr/bluetooth/gatt.h>
#include <zephyr/bluetooth/uuid.h>
#include <zephyr/bluetooth/services/bas.h>
#include <zephyr/bluetooth/services/hrs.h>

#include "service.h"

#define DEVICE_NAME "platynode"
#define DEVICE_NAME_LEN (sizeof(DEVICE_NAME) - 1)

static void start_advertising(struct k_work *work);
static K_WORK_DEFINE(start_advertising_worker, start_advertising);

static struct bt_le_ext_adv *adv;

static const struct bt_data ad[] = {
    BT_DATA_BYTES(BT_DATA_FLAGS, (BT_LE_AD_GENERAL | BT_LE_AD_NO_BREDR)),
    BT_DATA_BYTES(BT_DATA_UUID16_ALL,
                  BT_UUID_16_ENCODE(BT_UUID_DIS_VAL)),
    BT_DATA(BT_DATA_NAME_COMPLETE, DEVICE_NAME, DEVICE_NAME_LEN)};

static void connected(struct bt_conn *conn, uint8_t conn_err)
{
    int err;
    struct bt_conn_info info;
    char addr[BT_ADDR_LE_STR_LEN];

    bt_addr_le_to_str(bt_conn_get_dst(conn), addr, sizeof(addr));

    if (conn_err)
    {
        printk("Connection failed (err %d)\n", conn_err);
        return;
    }

    err = bt_conn_get_info(conn, &info);
    if (err)
    {
        printk("Failed to get connection info (err %d)\n", err);
    }
    else
    {
        printk("Connected: %s\n", addr);
    }
}

static void disconnected(struct bt_conn *conn, uint8_t reason)
{
    printk("Disconnected (reason 0x%02x)\n", reason);

    k_work_submit(&start_advertising_worker);
}

BT_CONN_CB_DEFINE(conn_callbacks) = {
    .connected = connected,
    .disconnected = disconnected,
};

static void start_advertising(struct k_work *work)
{
    int err;

    err = bt_le_adv_start(BT_LE_ADV_CONN_NAME, ad, ARRAY_SIZE(ad), NULL, 0);
    if (err)
    {
        printk("Advertising failed to start (err %d)\n", err);
        return;
    }

    printk("Advertising successfully started\n");
}

int bluetooth_init(void)
{
    int err;

    printk("Enabling bluetooth");
    err = bt_enable(NULL);
    if (err)
    {
        printk("Bluetooth init failed (err %d)\n", err);
        return 0;
    }
    printk("Bluetooth initialized\n");

    host_service_init();

    k_work_submit(&start_advertising_worker);

    return 0;
}

int bluetooth_disable(void)
{
    int err;

    printk("bluetooth_disable: Disabling bluetooth\n");

    err = bt_le_adv_stop();
    // err = bt_le_ext_adv_stop(adv);
    if (err)
    {
        printk("bluetooth_disable: Could not stop advertising(err %d)\n", err);
        return 0;
    }

    printk("bluetooth_disable: Advertising stopped\n");

    err = bt_disable();
    if (err)
    {
        printk("bluetooth_disable: Could not stop bt (err %d)\n", err);
        return 0;
    }

    printk("bluetooth_disable: BT stopped\n");

    return 0;
}

static void auth_cancel(struct bt_conn *conn)
{
    char addr[BT_ADDR_LE_STR_LEN];

    bt_addr_le_to_str(bt_conn_get_dst(conn), addr, sizeof(addr));

    printk("Pairing cancelled: %s\n", addr);
}

static struct bt_conn_auth_cb auth_cb_display = {
    .cancel = auth_cancel,
};

int bluetooth_enable(void)
{
    int err;

    printk("bluetooth_enable: Enabling bluetooth\n");
    err = bt_enable(NULL);
    if (err)
    {
        printk("bluetooth_enable: Bluetooth init failed (err %d)\n", err);
        return 0;
    }

    bt_conn_auth_cb_register(&auth_cb_display);

    k_work_submit(&start_advertising_worker);
    return 0;
}
```

## src/bluetooth.h
```c
// #ifndef BLUETOOTH_H_
// #define BLUETOOTH_H_

// int bluetooth_init(void);

// int bluetooth_enable(void);

// int bluetooth_disable(void);

// #endif
```

## src/flash.c
```c
#include "flash.h"

#include <zephyr/drivers/flash.h>
#include <zephyr/kernel.h>
#include <string.h>

static off_t fs_offset = 0;
static uint8_t current_part = 0;
static bool reached_end = false;

// XXX: this should ideally be checked for `device_is_ready()` at startup
struct device *fs_flash_device = NULL;

uint16_t round_to_pow2(uint16_t v)
{
    // See https://graphics.stanford.edu/%7Eseander/bithacks.html#RoundUpPowerOf2
    v--;
    v |= v >> 1;
    v |= v >> 2;
    v |= v >> 4;
    v |= v >> 8;
    return v + 1;
}

int fs_erase(struct device *d, uint8_t sectors)
{
    return flash_erase(d, 0, sectors * 4096);
}

void fs_init(void)
{
    printk("fs_init: Getting QSPI flash\n");
    if (fs_flash_device == NULL)
    {
        fs_flash_device = DEVICE_DT_GET(DT_ALIAS(spi_flash0));
        while (!device_is_ready(fs_flash_device))
        {
        }
    }
}

flash_read_t fs_read(struct device *d,
                     uint8_t *buf,
                     uint8_t part)
{
    flash_read_t ret;

    uint16_t len = 0;
    uint8_t header_buf[5];
    off_t offset = 0;

    if (!device_is_ready(d))
    {
        ret.res = FS_ERROR;
        return ret;
    }

    do
    {
        if (flash_read(d, offset, header_buf, 5) != 0)
        {
            ret.res = FS_ERROR;
            return ret;
        }

        // printk("fs_read: offset=%ld, %x %x %x %x %x\n", offset, header_buf[0], header_buf[1], header_buf[2], header_buf[3], header_buf[4]);

        // If no packet here
        if (header_buf[0] != 0xaa || header_buf[1] != 0xaa)
        {
            ret.res = FS_EOF;
            return ret;
        }

        len = (uint16_t)header_buf[3] | ((uint16_t)header_buf[4]) << 8;

        // header + len + first byte of next part
        offset += round_to_pow2(len + 5);

    } while (header_buf[2] < part);

    if (flash_read(d, offset - round_to_pow2(len + 5), buf, len + 5) != 0)
    {
        ret.res = FS_ERROR;
        return ret;
    }

    ret.bytes_read = len + 5;
    ret.res = FS_SUCCESS;
    return ret;
}

void fs_reset()
{
    fs_offset = 0;
}

int fs_skip_to_end(struct device *d)
{
    printk("fs_skip_to_end: start\n");
    int err = 0;

    if (reached_end)
    {
        printk("fs_skip_to_end: reached end\n");
        return 0;
    }

    if (!device_is_ready(d))
    {
        return -1;
    }

    uint16_t len = 0;
    uint8_t header_buf[5];

    while (fs_offset < FLASH_SIZE - 6)
    {
        printk("fs_skip_to_end: fs_offset=%u\n", fs_offset);
        err = flash_read(d, fs_offset, header_buf, 5);
        if (err != 0)
        {
            return err;
        }

        // If no packet here
        if (header_buf[0] != 0xaa || header_buf[1] != 0xaa)
        {
            // printk("reached end\n");
            reached_end = true;
            return 0;
        }

        len = header_buf[3] | header_buf[4] << 8;

        // header + len + first byte of next part
        fs_offset += len + 5 + 1;
        current_part = header_buf[2];
    }

    // Should never happen ideally
    return -1;
}

// Note that `len + 5` must be a power of 2
// This is not checked, handle user side
// Edit: Must be a factor of 4, see zephyr/drivers/flash/nrf_qspi_nor.c:qspi_nor_write()
int fs_write_packet(struct device *d, uint8_t *buf, uint16_t len)
{
    int err;
    if (!reached_end)
    {
        err = fs_skip_to_end(d);

        if (err != 0)
        {
            return err;
        }
    }

    uint16_t l = round_to_pow2(len + 5);

    printk("fs_write_packet: l %u len %u\n", l, len);

    uint8_t write_buf[l];

    write_buf[0] = 0xaa;
    write_buf[1] = 0xaa;
    write_buf[2] = current_part + 1;
    write_buf[3] = (uint8_t)len & 0xff;
    write_buf[4] = (uint8_t)(len >> 8) & 0xff;

    // printk("memcpy\n");

    memcpy(write_buf + 5, buf, len);

    printk("fs_write_packet: write offset=%u\n", fs_offset);

    err = flash_write(d, fs_offset, write_buf, l);
    if (err != 0)
    {
        return err;
    }

    current_part++;
    fs_offset += l;

    return 0;
}
```

## src/flash.h
```c
#ifndef _FLASH_H_
#define _FLASH_H_

#include <stdbool.h>
#include <stdint.h>

#include <zephyr/device.h>

#define FLASH_SIZE 16777216
#define FLASH_SECTOR_SIZE 4069

extern struct device *fs_flash_device;

typedef enum
{
    FS_SUCCESS = 0xFF,

    FS_ERROR = 0x00,
    FS_EOF = 0x01,
} flash_read_result_t;

typedef struct
{
    uint16_t bytes_read;
    flash_read_result_t res;
} flash_read_t;

flash_read_t fs_read(struct device *d,
                     uint8_t *buf,
                     uint8_t part);

int fs_skip_to_end(struct device *d);

int fs_write_packet(struct device *d, uint8_t *buf, uint16_t len);

int fs_erase(struct device *d, uint8_t sectors);

void fs_reset(void);

void fs_init(void);

#endif
```

## src/qspi_flash.c
```c
// Adapted from https://wiki.seeedstudio.com/xiao-ble-qspi-flash-usage/

#include "qspi_flash.h"

#include <stdbool.h>
#include <nrfx_qspi.h>
#include <stdint.h>

#include <zephyr/sys/printk.h>

// sdk_config definitions
#define NRFX_QSPI_CONFIG_XIP_OFFSET 0
#define NRFX_QSPI_CONFIG_IRQ_PRIORITY 7
#define NRFX_QSPI_CONFIG_ADDRMODE 0
#define NRFX_QSPI_CONFIG_MODE 0

#define QSPI_STD_CMD_WRSR 0x01
#define QSPI_STD_CMD_RSTEN 0x66
#define QSPI_STD_CMD_RST 0x99
#define QSPI_DPM_ENTER 0x0003 // 3 x 256 x 62.5ns = 48ms
#define QSPI_DPM_EXIT 0x0003

static uint32_t *QSPI_Status_Ptr = (uint32_t *)0x40029604; // Setup for the SEEED XIAO BLE - nRF52840
static nrfx_qspi_config_t QSPIConfig;
static nrf_qspi_cinstr_conf_t QSPICinstr_cfg;
// static const uint32_t MemToUse = 64 * 1024; // Alter this to create larger read writes, 64Kb is the size of the Erase
static bool Debug_On = true;
// static uint16_t pBuf[32768] = {0}; // 16bit used as that is what this memory is going to be used for
// static uint32_t *BufMem = (uint32_t *)&pBuf;
static bool QSPIWait = false;

void QSPI_Status(char ASender[])
{ // Prints the QSPI Status
    printk("(");
    // printk("", ASender);
    printk(") QSPI is busy/idle ... Result = ");
    printk("%x\n", nrfx_qspi_mem_busy_check() & 8);
    printk("(");
    // printk(ASender);
    printk(") QSPI Status flag = 0x");
    printk("%x", NRF_QSPI->STATUS);
    printk(" (from NRF_QSPI) or 0x");
    printk("%x", *QSPI_Status_Ptr);
    printk(" (from *QSPI_Status_Ptr)\n");
}

static void QSPI_PrintData(uint16_t *AnAddress, uint32_t AnAmount)
{
    uint32_t i;

    printk("Data :");
    for (i = 0; i < AnAmount; i++)
    {
        printk(" 0x%x", *(AnAddress + i));
    }
    printk("\n");
}

nrfx_err_t QSPI_IsReady()
{
    if (((*QSPI_Status_Ptr & 8) == 8) && (*QSPI_Status_Ptr & 0x01000000) == 0)
    {
        return NRFX_SUCCESS;
    }
    else
    {
        return NRFX_ERROR_BUSY;
    }
}

nrfx_err_t QSPI_WaitForReady()
{
    while (QSPI_IsReady() == NRFX_ERROR_BUSY)
    {
        printk("busy\n");
        // if (Debug_On)
        // {
        //     printk("*QSPI_Status_Ptr & 8 = ");
        //     printk("%x", *QSPI_Status_Ptr & 8);
        //     printk(", *QSPI_Status_Ptr & 0x01000000 = 0x");
        //     printk("%x", *QSPI_Status_Ptr & 0x01000000);
        //     QSPI_Status("QSPI_WaitForReady");
        // }
    }
    return NRFX_SUCCESS;
}

nrfx_err_t QSPI_Initialise()
{
    // Initialises the QSPI and NRF LOG
    uint32_t Error_Code;

    // QSPI Config
    QSPIConfig.xip_offset = NRFX_QSPI_CONFIG_XIP_OFFSET;
    QSPIConfig.pins = (nrf_qspi_pins_t){
        // Setup for the SEEED XIAO BLE - nRF52840
        .sck_pin = 21,
        .csn_pin = 25,
        .io0_pin = 20,
        .io1_pin = 24,
        .io2_pin = 22,
        .io3_pin = 23,
    };
    QSPIConfig.irq_priority = (uint8_t)NRFX_QSPI_CONFIG_IRQ_PRIORITY;
    QSPIConfig.prot_if = (nrf_qspi_prot_conf_t){
        // .readoc     = (nrf_qspi_readoc_t)NRFX_QSPI_CONFIG_READOC,
        .readoc = (nrf_qspi_readoc_t)NRF_QSPI_READOC_READ4O,
        // .writeoc    = (nrf_qspi_writeoc_t)NRFX_QSPI_CONFIG_WRITEOC,
        .writeoc = (nrf_qspi_writeoc_t)NRF_QSPI_WRITEOC_PP4O,
        .addrmode = (nrf_qspi_addrmode_t)NRFX_QSPI_CONFIG_ADDRMODE,
        .dpmconfig = false,
    };
    QSPIConfig.phy_if.sck_freq = (nrf_qspi_frequency_t)NRF_QSPI_FREQ_32MDIV1; // I had to do it this way as it complained about nrf_qspi_phy_conf_t not being visible
    // QSPIConfig.phy_if.sck_freq   = (nrf_qspi_frequency_t)NRFX_QSPI_CONFIG_FREQUENCY;
    QSPIConfig.phy_if.spi_mode = (nrf_qspi_spi_mode_t)NRFX_QSPI_CONFIG_MODE;
    QSPIConfig.phy_if.dpmen = false;
    // QSPI Config Complete
    // Setup QSPI to allow for DPM but with it turned off
    QSPIConfig.prot_if.dpmconfig = true;
    // NRF_QSPI->DPMDUR = (QSPI_DPM_ENTER << 16) | QSPI_DPM_EXIT; // Found this on the Nordic Q&A pages, Sets the Deep power-down mode timer

    printk("Starting\n");

    Error_Code = 1;
    while (Error_Code != 0)
    {
        Error_Code = nrfx_qspi_init(&QSPIConfig, NULL, NULL);
        if (Error_Code != NRFX_SUCCESS)
        {
            if (Debug_On)
            {
                printk("(QSPI_Initialise) nrfx_qspi_init returned : %u\n", Error_Code);
            }
        }
        else
        {
            if (Debug_On)
            {
                printk("(QSPI_Initialise) nrfx_qspi_init successful\n");
            }
        }
    }
    QSPI_Status("QSPI_Initialise (Before QSPI_Configure_Memory)");
    QSPI_Configure_Memory();
    if (Debug_On)
    {
        printk("(QSPI_Initialise) Wait for QSPI to be ready ...\n");
    }
    NRF_QSPI->TASKS_ACTIVATE = 1;
    QSPI_WaitForReady();
    if (Debug_On)
    {
        printk("(QSPI_Initialise) QSPI is ready\n");
    }
    return QSPI_IsReady();
}

void QSPI_Erase(uint32_t AStartAddress)
{
    bool QSPIReady = false;
    bool AlreadyPrinted = false;

    if (Debug_On)
    {
        printk("(QSPI_Erase) Erasing memory\n");
    }
    while (!QSPIReady)
    {
        if (QSPI_IsReady() != NRFX_SUCCESS)
        {
            if (!AlreadyPrinted)
            {
                QSPI_Status("QSPI_Erase (Waiting)");
                AlreadyPrinted = true;
            }
        }
        else
        {
            QSPIReady = true;
            QSPI_Status("QSPI_Erase (Waiting Loop Breakout)");
        }
    }
    if (Debug_On)
    {
        QSPI_Status("QSPI_Erase (Finished Waiting)");
        // TimeTaken = millis();
    }
    if (nrfx_qspi_erase(NRF_QSPI_ERASE_LEN_64KB, AStartAddress) != NRFX_SUCCESS)
    {
        if (Debug_On)
        {
            printk("(QSPI_Initialise_Page) QSPI Address 0x");
            printk("%x", AStartAddress);
            printk(" failed to erase!\n");
        }
    }
    else
    {
        // if (Debug_On)
        // {
        // TimeTaken = millis() - TimeTaken;
        // printk("(QSPI_Initialise_Page) QSPI took ");
        // printk(TimeTaken);
        // printkln("ms to erase a 64Kb page");
        // }
    }
}

void QSPI_Configure_Memory(void)
{
    // uint8_t  temporary = 0x40;
    uint8_t temporary[] = {0x00, 0x02};
    // uint32_t Error_Code;

    QSPICinstr_cfg = (nrf_qspi_cinstr_conf_t){
        .opcode = QSPI_STD_CMD_RSTEN,
        .length = NRF_QSPI_CINSTR_LEN_1B,
        .io2_level = true,
        .io3_level = true,
        .wipwait = QSPIWait,
        .wren = true};
    QSPI_WaitForReady();
    if (nrfx_qspi_cinstr_xfer(&QSPICinstr_cfg, NULL, NULL) != NRFX_SUCCESS)
    { // Send reset enable
        if (Debug_On)
        {
            printk("(QSPI_Configure_Memory) QSPI 'Send reset enable' failed!\n");
        }
    }
    else
    {
        QSPICinstr_cfg.opcode = QSPI_STD_CMD_RST;
        QSPI_WaitForReady();
        if (nrfx_qspi_cinstr_xfer(&QSPICinstr_cfg, NULL, NULL) != NRFX_SUCCESS)
        { // Send reset command
            if (Debug_On)
            {
                printk("(QSPI_Configure_Memory) QSPI Reset failed!\n");
            }
        }
        else
        {
            QSPICinstr_cfg.opcode = QSPI_STD_CMD_WRSR;
            QSPICinstr_cfg.length = NRF_QSPI_CINSTR_LEN_3B;
            QSPI_WaitForReady();
            if (nrfx_qspi_cinstr_xfer(&QSPICinstr_cfg, &temporary, NULL) != NRFX_SUCCESS)
            { // Switch to qspi mode
                if (Debug_On)
                {
                    printk("(QSPI_Configure_Memory) QSPI failed to switch to QSPI mode!\n");
                }
            }
            else
            {
                QSPI_Status("QSPI_Configure_Memory");
            }
        }
    }
}
```

## src/qspi_flash.h
```c
#ifndef _QSPI_FLASH_H_
#define _QSPI_FLASH_H_

#include "nrfx_qspi.h"

void QSPI_Configure_Memory(void);

nrfx_err_t QSPI_IsReady();

nrfx_err_t QSPI_WaitForReady();

nrfx_err_t QSPI_Initialise();

void QSPI_Status(char ASender[]);

void QSPI_Erase(uint32_t AStartAddress);

void QSPI_Configure_Memory(void);

#endif
```

## src/radio.c
```c
/*
 * Copyright (c) 2020 Nordic Semiconductor ASA
 *
 * SPDX-License-Identifier: LicenseRef-Nordic-5-Clause
 */

#include "radio.h"

#include <hal/nrf_power.h>

#include <nrfx_timer.h>
#include <zephyr/kernel.h>

#include <helpers/nrfx_gppi.h>

#include <zephyr/drivers/gpio.h>

#include <string.h>

#include "flash.h"

uint32_t radio_is_active_counter = 0;

/* Length on air of the LENGTH field. */
#define RADIO_LENGTH_LENGTH_FIELD (8UL)

#define RADIO_TEST_TIMER_INSTANCE 0

#define RADIO_TEST_EGU NRF_EGU0
#define RADIO_TEST_EGU_EVENT NRF_EGU_EVENT_TRIGGERED0
#define RADIO_TEST_EGU_TASK NRF_EGU_TASK_TRIGGER0

/* Frequency calculation for a given channel in the IEEE 802.15.4 radio
 * mode.
 */
#define IEEE_FREQ_CALC(_channel) (IEEE_DEFAULT_FREQ +  \
								  (IEEE_DEFAULT_FREQ * \
								   ((_channel)-IEEE_MIN_CHANNEL)))
/* Frequency calculation for a given channel. */
#define CHAN_TO_FREQ(_channel) (2400 + _channel)

/* Buffer for the radio TX packet */
static uint8_t tx_packet[RADIO_MAX_PAYLOAD_LEN];
/* Buffer for the radio RX packet. */
static uint8_t rx_packet[RADIO_MAX_PAYLOAD_LEN];
/* Number of transmitted packets. */
static uint32_t tx_packet_cnt;
/* Number of received packets with valid CRC. */
static uint32_t rx_packet_cnt;
/* Most recent measured RSSI value */
static uint8_t rssi;

/* Radio current channel (frequency). */
static uint8_t current_channel;

/* Timer used for channel sweeps and tx with duty cycle. */
static const nrfx_timer_t timer = NRFX_TIMER_INSTANCE(RADIO_TEST_TIMER_INSTANCE);

/* Total payload size */
static uint16_t total_payload_size;

/* PPI channel for starting radio */
static uint8_t ppi_radio_start;

/* Packet size to use */
uint8_t packet_size = RADIO_MAX_PAYLOAD_LEN - 1;

/* RX packets statistics */
uint32_t radio_total_rssi;
uint32_t radio_packets_received;
uint32_t radio_total_crcok;
bool radio_has_received;
// For logging
static uint8_t rx_log_buf[RADIO_MAX_PAYLOAD_LEN + 4 * 4 + 2];
bool radio_logging_active = false;

/* TX packets statistics */
uint32_t radio_packets_sent;

static void radio_power_set(nrf_radio_mode_t mode, uint8_t channel, int8_t power)
{
	int8_t radio_power = power;

	ARG_UNUSED(mode);
	ARG_UNUSED(channel);

	nrf_radio_txpower_set(NRF_RADIO, (nrf_radio_txpower_t)radio_power);
}

static void radio_channel_set(nrf_radio_mode_t mode, uint8_t channel)
{
	uint16_t frequency;

	frequency = CHAN_TO_FREQ(channel);
	nrf_radio_frequency_set(NRF_RADIO, frequency);
}

static void radio_config(nrf_radio_mode_t mode, enum transmit_pattern pattern)
{
	nrf_radio_packet_conf_t packet_conf;

	/* Set fast ramp-up time. */
	nrf_radio_modecnf0_set(NRF_RADIO, true, RADIO_MODECNF0_DTX_Center);
	/* Disable CRC. */
	nrf_radio_crc_configure(NRF_RADIO, RADIO_CRCCNF_LEN_Disabled,
							NRF_RADIO_CRC_ADDR_INCLUDE, 0);

	/* Set the device address 0 to use when transmitting. */
	nrf_radio_txaddress_set(NRF_RADIO, 0);
	/* Enable the device address 0 to use to select which addresses to
	 * receive
	 */
	nrf_radio_rxaddresses_set(NRF_RADIO, 1);
	nrf_radio_prefix0_set(NRF_RADIO, 0x6A);
	nrf_radio_base0_set(NRF_RADIO, 0x58FE811B);

	/* Packet configuration:
	 * payload length size = 8 bits,
	 * 0-byte static length, max 255-byte payload,
	 * 4-byte base address length (5-byte full address length),
	 * Bit 24: 1 Big endian,
	 * Bit 25: 1 Whitening enabled.
	 */
	memset(&packet_conf, 0, sizeof(packet_conf));
	packet_conf.lflen = RADIO_LENGTH_LENGTH_FIELD;
	packet_conf.maxlen = packet_size;
	// packet_conf.maxlen = (sizeof(tx_packet) - 1);
	packet_conf.statlen = 0;
	packet_conf.balen = 4;
	packet_conf.big_endian = true;
	packet_conf.whiteen = true;

	/* Packet configuration:
	 * S1 size = 0 bits,
	 * S0 size = 0 bytes,
	 * 10 bytes preamble.
	 */
	packet_conf.plen = NRF_RADIO_PREAMBLE_LENGTH_LONG_RANGE;
	packet_conf.cilen = 2;
	packet_conf.termlen = 3;
	packet_conf.big_endian = false;
	packet_conf.balen = 3;

	/* Set CRC length; CRC calculation does not include the address
	 * field.
	 */
	nrf_radio_crc_configure(NRF_RADIO, RADIO_CRCCNF_LEN_Three,
							NRF_RADIO_CRC_ADDR_SKIP, 0);

	/* preamble, address (BALEN + PREFIX), lflen, code indicator, TERM, payload, CRC */
	total_payload_size = 10 + (packet_conf.balen + 1) + 1 + packet_conf.cilen +
						 packet_conf.termlen + packet_conf.maxlen + RADIO_CRCCNF_LEN_Three;

	nrf_radio_packet_configure(NRF_RADIO, &packet_conf);
}

static void radio_disable(void)
{
	nrf_radio_shorts_set(NRF_RADIO, 0);
	nrf_radio_int_disable(NRF_RADIO, ~0);
	nrf_radio_event_clear(NRF_RADIO, NRF_RADIO_EVENT_DISABLED);

	nrf_radio_task_trigger(NRF_RADIO, NRF_RADIO_TASK_DISABLE);
	while (!nrf_radio_event_check(NRF_RADIO, NRF_RADIO_EVENT_DISABLED))
	{
		/* Do nothing */
	}
	nrf_radio_event_clear(NRF_RADIO, NRF_RADIO_EVENT_DISABLED);
}

static void radio_mode_set(NRF_RADIO_Type *reg, nrf_radio_mode_t mode)
{

	nrf_radio_mode_set(reg, mode);
}

static void radio_modulated_tx_carrier(uint8_t mode, int8_t txpower, uint8_t channel,
									   enum transmit_pattern pattern)
{
	radio_disable();
	radio_config(mode, pattern);
	// tx_packet[0] = sizeof(tx_packet) - 1;
	tx_packet[0] = packet_size;
	memset(tx_packet + 1, 0xF0, sizeof(tx_packet) - 1);
	nrf_radio_packetptr_set(NRF_RADIO, tx_packet);

	if (mode == RADIO_MODE_MODE_Ble_LR125Kbit || mode == RADIO_MODE_MODE_Ble_LR500Kbit)
	{
		nrf_radio_shorts_enable(NRF_RADIO,
								NRF_RADIO_SHORT_READY_START_MASK |
									NRF_RADIO_SHORT_PHYEND_START_MASK);
	}
	else
	{
		nrf_radio_shorts_enable(NRF_RADIO,
								NRF_RADIO_SHORT_READY_START_MASK |
									NRF_RADIO_SHORT_END_START_MASK);
	}

	radio_mode_set(NRF_RADIO, mode);
	radio_power_set(mode, channel, txpower);

	radio_channel_set(mode, channel);

	tx_packet_cnt = 0;

	nrf_radio_event_clear(NRF_RADIO, NRF_RADIO_EVENT_END);
	nrf_radio_event_clear(NRF_RADIO, NRF_RADIO_EVENT_PHYEND);

	if (mode == RADIO_MODE_MODE_Ble_LR125Kbit || mode == RADIO_MODE_MODE_Ble_LR500Kbit)
	{
		nrf_radio_int_enable(NRF_RADIO, NRF_RADIO_INT_PHYEND_MASK);
	}
	else
	{
		nrf_radio_int_enable(NRF_RADIO, NRF_RADIO_INT_END_MASK);
	}

	nrf_radio_task_trigger(NRF_RADIO, NRF_RADIO_TASK_TXEN);
}

static void radio_rx(uint8_t mode, uint8_t channel, enum transmit_pattern pattern)
{
	radio_disable();

	radio_mode_set(NRF_RADIO, mode);
	nrf_radio_shorts_enable(NRF_RADIO,
							NRF_RADIO_SHORT_READY_START_MASK |
								NRF_RADIO_SHORT_END_START_MASK |
								NRF_RADIO_SHORT_ADDRESS_RSSISTART_MASK |
								NRF_RADIO_SHORT_DISABLED_RSSISTOP_MASK);
	nrf_radio_packetptr_set(NRF_RADIO, rx_packet);

	radio_config(mode, pattern);
	radio_channel_set(mode, channel);

	rx_packet_cnt = 0;

	nrf_radio_int_enable(NRF_RADIO,
						 NRF_RADIO_INT_CRCOK_MASK |
							 NRF_RADIO_INT_RSSIEND_MASK |
							 NRF_RADIO_INT_ADDRESS_MASK);

	nrf_radio_task_trigger(NRF_RADIO, NRF_RADIO_TASK_RXEN);
}

void radio_test_start(const struct radio_test_config *config)
{
	switch (config->type)
	{
	case MODULATED_TX:
		radio_modulated_tx_carrier(config->mode,
								   config->params.modulated_tx.txpower,
								   config->params.modulated_tx.channel,
								   config->params.modulated_tx.pattern);
		break;
	case RX:
		radio_rx(config->mode,
				 config->params.rx.channel,
				 config->params.rx.pattern);
		break;
	}
}

void radio_test_cancel(void)
{
	nrfx_timer_disable(&timer);
	nrfx_timer_clear(&timer);

	// sweep_processing = false;

	nrfx_gppi_channels_disable(BIT(ppi_radio_start));
	// nrfx_gppi_event_endpoint_clear(ppi_radio_start,
	// 							   nrf_egu_event_address_get(RADIO_TEST_EGU, RADIO_TEST_EGU_EVENT));
	nrfx_gppi_task_endpoint_clear(ppi_radio_start,
								  nrf_radio_task_address_get(NRF_RADIO, NRF_RADIO_TASK_TXEN));
	nrfx_gppi_task_endpoint_clear(ppi_radio_start,
								  nrf_radio_task_address_get(NRF_RADIO, NRF_RADIO_TASK_RXEN));
	nrfx_gppi_fork_endpoint_clear(ppi_radio_start,
								  nrf_timer_task_address_get(timer.p_reg, NRF_TIMER_TASK_START));
	nrfx_gppi_event_endpoint_clear(ppi_radio_start,
								   nrf_timer_event_address_get(timer.p_reg, NRF_TIMER_EVENT_COMPARE1));

	radio_disable();
}

void radio_rx_stats_get(struct radio_rx_stats *rx_stats)
{
	size_t size;
	size = sizeof(rx_packet);
	rx_stats->last_packet.buf = rx_packet;
	rx_stats->last_packet.len = size;
	rx_stats->packet_cnt = rx_packet_cnt;
}

static uint16_t write_rx_stats_to_buf()
{
	rx_log_buf[0] = radio_total_rssi & 0xFF;
	rx_log_buf[1] = (radio_total_rssi >> 8) & 0xFF;
	rx_log_buf[2] = (radio_total_rssi >> 16) & 0xFF;
	rx_log_buf[3] = (radio_total_rssi >> 24) & 0xFF;

	rx_log_buf[4] = radio_packets_received & 0xFF;
	rx_log_buf[5] = (radio_packets_received >> 8) & 0xFF;
	rx_log_buf[6] = (radio_packets_received >> 16) & 0xFF;
	rx_log_buf[7] = (radio_packets_received >> 24) & 0xFF;

	rx_log_buf[8] = radio_total_crcok & 0xFF;
	rx_log_buf[9] = (radio_total_crcok >> 8) & 0xFF;
	rx_log_buf[10] = (radio_total_crcok >> 16) & 0xFF;
	rx_log_buf[11] = (radio_total_crcok >> 24) & 0xFF;

	uint32_t ticks = NRF_TIMER2->CC[1];

	rx_log_buf[12] = ticks & 0xFF;
	rx_log_buf[13] = (ticks >> 8) & 0xFF;
	rx_log_buf[14] = (ticks >> 16) & 0xFF;
	rx_log_buf[15] = (ticks >> 24) & 0xFF;

	rx_log_buf[16] = rssi;
	rx_log_buf[17] = packet_size;

	memcpy(rx_log_buf + 18, rx_packet, packet_size);

	return 18 + packet_size;
}

static void write_rx_log_thread(void)
{
	while (true)
	{
		if (radio_logging_active)
		{
			uint16_t rx_stats_bytes = write_rx_stats_to_buf();

			printk("write_rx_log_thread: writing\n");
			int err = fs_write_packet(fs_flash_device, rx_log_buf, rx_stats_bytes);
			if (err != 0)
			{
				printk("write_rx_log_thread: fs_write_packet err=%d\n", err);
			}
			k_msleep(250);
		}
		else
		{
			k_msleep(100);
		}
	}
}

void radio_handler()
{
	if (nrf_radio_event_check(NRF_RADIO, NRF_RADIO_EVENT_CRCOK))
	{
		nrf_radio_event_clear(NRF_RADIO, NRF_RADIO_EVENT_CRCOK);

		radio_is_active_counter = 1000;

		radio_total_crcok++;
	}

	if (nrf_radio_event_check(NRF_RADIO, NRF_RADIO_EVENT_RSSIEND))
	{
		nrf_radio_event_clear(NRF_RADIO, NRF_RADIO_EVENT_RSSIEND);

		rssi = nrf_radio_rssi_sample_get(NRF_RADIO);

		// Stop after 1 sample
		nrf_radio_task_trigger(NRF_RADIO, NRF_RADIO_TASK_RSSISTOP);

		radio_total_rssi += rssi;
	}

	if (nrf_radio_event_check(NRF_RADIO, NRF_RADIO_EVENT_ADDRESS))
	{
		nrf_radio_event_clear(NRF_RADIO, NRF_RADIO_EVENT_ADDRESS);

		if (!radio_has_received)
		{
			radio_has_received = true;

			// Store when the first packet is received into CC[0]
			NRF_TIMER2->TASKS_CAPTURE[0] = TIMER_TASKS_CAPTURE_TASKS_CAPTURE_Trigger;
		}

		NRF_TIMER2->TASKS_CAPTURE[1] = TIMER_TASKS_CAPTURE_TASKS_CAPTURE_Trigger;

		radio_packets_received++;
	}

	if (nrf_radio_event_check(NRF_RADIO, NRF_RADIO_EVENT_END) | nrf_radio_event_check(NRF_RADIO, NRF_RADIO_EVENT_PHYEND))
	{
		nrf_radio_event_clear(NRF_RADIO, NRF_RADIO_EVENT_END);
		nrf_radio_event_clear(NRF_RADIO, NRF_RADIO_EVENT_PHYEND);

		radio_packets_sent++;
		radio_is_active_counter = 1000;
	}
}

int radio_test_init()
{
	// Radio handler only counts sent/received packets
	// IRQ_CONNECT(RADIO_IRQn, IRQ_PRIO_LOWEST, radio_handler, NULL, 0);
	irq_connect_dynamic(RADIO_IRQn, IRQ_PRIO_LOWEST, radio_handler, NULL, 0);
	irq_enable(RADIO_IRQn);

	return 0;
}

K_THREAD_DEFINE(write_rx_log_thread_id, 1024, write_rx_log_thread, NULL, NULL, NULL,
				6, 0, 0);
```

## src/radio.h
```c
/*
 * Copyright (c) 2020 Nordic Semiconductor ASA
 *
 * SPDX-License-Identifier: LicenseRef-Nordic-5-Clause
 */

#ifndef RADIO_TEST_H_
#define RADIO_TEST_H_

#include <zephyr/types.h>
#include <hal/nrf_radio.h>

/** Maximum radio RX or TX payload. */
#define RADIO_MAX_PAYLOAD_LEN 256
/** IEEE 802.15.4 maximum payload length. */
#define IEEE_MAX_PAYLOAD_LEN 127
/** IEEE 802.15.4 minimum channel. */
#define IEEE_MIN_CHANNEL 11
/** IEEE 802.15.4 maximum channel. */
#define IEEE_MAX_CHANNEL 26

#define FEM_USE_DEFAULT_GAIN 0xFF

extern uint32_t radio_is_active_counter;
extern uint32_t radio_total_rssi;
extern uint32_t radio_packets_received;
extern uint32_t radio_total_crcok;
extern bool radio_has_received;

extern uint8_t packet_size;

extern uint32_t radio_packets_sent;

extern bool radio_logging_active;

/**@brief Radio transmit and address pattern. */
enum transmit_pattern
{
	/** Random pattern. */
	TRANSMIT_PATTERN_RANDOM,

	/** Pattern 11110000(F0). */
	TRANSMIT_PATTERN_11110000,

	/** Pattern 11001100(CC). */
	TRANSMIT_PATTERN_11001100,
};

/**@brief Radio test mode. */
enum radio_test_mode
{
	/** TX carrier. */
	UNMODULATED_TX,

	/** Modulated TX carrier. */
	MODULATED_TX,

	/** RX carrier. */
	RX,

	/** TX carrier sweep. */
	TX_SWEEP,

	/** RX carrier sweep. */
	RX_SWEEP,

	/** Duty-cycled modulated TX carrier. */
	MODULATED_TX_DUTY_CYCLE,
};

/**@brief Radio test front-end module (FEM) configuration */
struct radio_test_fem
{
	/* Front-end module radio ramp-up time in microseconds. */
	uint32_t ramp_up_time;

	/* Front-end module TX gain in arbitrary unit specific to given front-end module.
	 * For nRF21540 GPIO/SPI, this is a register value.
	 * For nRF21540 GPIO, this is MODE pin value.
	 */
	uint8_t gain;
};

/**@brief Radio test configuration. */
struct radio_test_config
{
	/** Radio test type. */
	enum radio_test_mode type;

	/** Radio mode. Data rate and modulation. */
	nrf_radio_mode_t mode;

	union
	{
		struct
		{
			/** Radio output power. */
			int8_t txpower;

			/** Radio channel. */
			uint8_t channel;
		} unmodulated_tx;

		struct
		{
			/** Radio output power. */
			int8_t txpower;

			/** Radio transmission pattern. */
			enum transmit_pattern pattern;

			/** Radio channel. */
			uint8_t channel;

			/**
			 * Number of pacets to transmit.
			 * Set to zero for continuous TX.
			 */
			uint32_t packets_num;

			/** Callback to indicate that TX is finished. */
			void (*cb)(void);
		} modulated_tx;

		struct
		{
			/** Radio transmission pattern. */
			enum transmit_pattern pattern;

			/** Radio channel. */
			uint8_t channel;
		} rx;

		struct
		{
			/** Radio output power. */
			int8_t txpower;

			/** Radio start channel (frequency). */
			uint8_t channel_start;

			/** Radio end channel (frequency). */
			uint8_t channel_end;

			/** Delay time in milliseconds. */
			uint32_t delay_ms;
		} tx_sweep;

		struct
		{
			/** Radio start channel (frequency). */
			uint8_t channel_start;

			/** Radio end channel (frequency). */
			uint8_t channel_end;

			/** Delay time in milliseconds. */
			uint32_t delay_ms;
		} rx_sweep;

		struct
		{
			/** Radio output power. */
			int8_t txpower;

			/** Radio transmission pattern. */
			enum transmit_pattern pattern;

			/** Radio channel. */
			uint8_t channel;

			/** Duty cycle. */
			uint32_t duty_cycle;
		} modulated_tx_duty_cycle;
	} params;

#if CONFIG_FEM
	/* Front-end module (FEM) configuration. */
	struct radio_test_fem fem;
#endif /* CONFIG_FEM */
};

/**@brief Radio RX statistics. */
struct radio_rx_stats
{
	/** Content of the last packet. */
	struct
	{
		/** Content of the last packet. */
		uint8_t *buf;

		/** Length of the last packet. */
		size_t len;
	} last_packet;

	/** Number of received packets with valid CRC. */
	uint32_t packet_cnt;
};

/**
 * @brief Function for initializing the Radio Test module.
 *
 * @param[in] config  Radio test configuration.
 *
 * @retval 0 If the operation was successful.
 *           Otherwise, a (negative) error code is returned.
 */
int radio_test_init();

/**
 * @brief Function for starting radio test.
 *
 * @param[in] config  Radio test configuration.
 */
void radio_test_start(const struct radio_test_config *config);

/**
 * @brief Function for stopping ongoing test (Radio and Timer operations).
 */
void radio_test_cancel(void);

/**
 * @brief Function for get RX statistics.
 *
 * @param[out] rx_stats RX statistics.
 */
void radio_rx_stats_get(struct radio_rx_stats *rx_stats);

/**
 * @brief Function for toggling the DC/DC converter state.
 *
 * @param[in] dcdc_state  DC/DC converter state.
 */
void toggle_dcdc_state(uint8_t dcdc_state);

#endif /* RADIO_TEST_H_ */
```

## src/radio_cmd.c
```c
// /*
//  * Copyright (c) 2020 Nordic Semiconductor ASA
//  *
//  * SPDX-License-Identifier: LicenseRef-Nordic-5-Clause
//  */

// #include <stdlib.h>

// #include <errno.h>
// #include <zephyr/init.h>
// #include <zephyr/shell/shell.h>
// #include <zephyr/types.h>
// #include <hal/nrf_power.h>

// #include "radio.h"

// /* Radio parameter configuration. */
// static struct radio_param_config
// {
// 	/** Radio transmission pattern. */
// 	enum transmit_pattern tx_pattern;

// 	/** Radio mode. Data rate and modulation. */
// 	nrf_radio_mode_t mode;

// 	/** Radio output power. */
// 	uint8_t txpower;

// 	/** Radio start channel (frequency). */
// 	uint8_t channel_start;

// 	/** Radio end channel (frequency). */
// 	uint8_t channel_end;

// 	/** Delay time in milliseconds. */
// 	uint32_t delay_ms;

// 	/** Duty cycle. */
// 	uint32_t duty_cycle;
// } config = {
// 	.tx_pattern = TRANSMIT_PATTERN_11110000,
// 	// .mode = NRF_RADIO_MODE_BLE_1MBIT,
// 	.mode = NRF_RADIO_MODE_BLE_LR125KBIT,
// 	.txpower = RADIO_TXPOWER_TXPOWER_Pos8dBm,
// 	.channel_start = 0,
// 	.channel_end = 80,
// 	.delay_ms = 10,
// 	.duty_cycle = 50,
// };

// /* Radio test configuration. */
// static struct radio_test_config test_config;

// static int cmd_cancel(const struct shell *shell, size_t argc, char **argv)
// {
// 	radio_test_cancel();
// 	return 0;
// }

// static int cmd_tx_carrier_start(const struct shell *shell, size_t argc,
// 								char **argv)
// {
// 	// ieee_channel_check(shell, config.channel_start);
// 	memset(&test_config, 0, sizeof(test_config));
// 	test_config.type = UNMODULATED_TX;
// 	test_config.mode = config.mode;
// 	test_config.params.unmodulated_tx.txpower = config.txpower;
// 	test_config.params.unmodulated_tx.channel = config.channel_start;
// 	radio_test_start(&test_config);

// 	shell_print(shell, "Start the TX carrier");
// 	return 0;
// }

// static int cmd_tx_start(const struct shell *shell,
// 						size_t argc,
// 						char **argv)
// {

// 	if (argc > 2)
// 	{
// 		shell_error(shell, "%s: bad parameters count.", argv[0]);
// 		return -EINVAL;
// 	}

// 	memset(&test_config, 0, sizeof(test_config));
// 	test_config.type = MODULATED_TX;
// 	test_config.mode = config.mode;
// 	test_config.params.modulated_tx.txpower = config.txpower;
// 	test_config.params.modulated_tx.channel = config.channel_start;
// 	test_config.params.modulated_tx.pattern = config.tx_pattern;

// 	if (argc == 2)
// 	{
// 		test_config.params.modulated_tx.packets_num = atoi(argv[1]);
// 	}

// 	radio_test_start(&test_config);

// 	shell_print(shell, "Start the modulated TX carrier");
// 	return 0;
// }

// static int cmd_rx_start(const struct shell *shell, size_t argc, char **argv)
// {
// 	// config.txpower = RADIO_TXPOWER_TXPOWER_Pos8dBm;
// 	// ieee_channel_check(shell, config.channel_start);
// 	memset(&test_config, 0, sizeof(test_config));
// 	test_config.type = RX;
// 	test_config.mode = config.mode;
// 	test_config.params.rx.channel = config.channel_start;
// 	test_config.params.rx.pattern = config.tx_pattern;
// 	radio_test_start(&test_config);
// 	return 0;
// }

// static int cmd_print_payload(const struct shell *shell, size_t argc,
// 							 char **argv)
// {
// 	struct radio_rx_stats rx_stats;

// 	memset(&rx_stats, 0, sizeof(rx_stats));

// 	radio_rx_stats_get(&rx_stats);

// 	shell_print(shell, "Received payload:");
// 	shell_hexdump(shell, rx_stats.last_packet.buf,
// 				  rx_stats.last_packet.len);
// 	shell_print(shell, "Number of packets: %d", rx_stats.packet_cnt);

// 	return 0;
// }

// SHELL_CMD_REGISTER(cancel, NULL, "Cancel the sweep or the carrier",
// 				   cmd_cancel);
// SHELL_CMD_REGISTER(start_tx, NULL,
// 				   "Start the modulated TX carrier",
// 				   cmd_tx_start);
// SHELL_CMD_REGISTER(start_rx, NULL, "Start RX", cmd_rx_start);
// SHELL_CMD_REGISTER(print_rx, NULL, "Print RX payload", cmd_print_payload);

// static int radio_cmd_init(void)
// {
// 	return radio_test_init(&test_config);
// }

// SYS_INIT(radio_cmd_init, APPLICATION, CONFIG_KERNEL_INIT_PRIORITY_DEVICE);
```

## src/radio_test.c
```c
/*
 * Copyright (c) 2020 Nordic Semiconductor ASA
 *
 * SPDX-License-Identifier: LicenseRef-Nordic-5-Clause
 */

#include "radio_test.h"

#include <string.h>
#include <inttypes.h>

#include <hal/nrf_power.h>

#include <nrfx_timer.h>
#include <zephyr/kernel.h>
#include <zephyr/random/rand32.h>

#include <hal/nrf_egu.h>
#include <helpers/nrfx_gppi.h>

/* Length on air of the LENGTH field. */
#define RADIO_LENGTH_LENGTH_FIELD (8UL)

#define RADIO_TEST_TIMER_INSTANCE 0

#define RADIO_TEST_EGU NRF_EGU0
#define RADIO_TEST_EGU_EVENT NRF_EGU_EVENT_TRIGGERED0
#define RADIO_TEST_EGU_TASK NRF_EGU_TASK_TRIGGER0

/* Frequency calculation for a given channel in the IEEE 802.15.4 radio
 * mode.
 */
#define IEEE_FREQ_CALC(_channel) (IEEE_DEFAULT_FREQ +  \
								  (IEEE_DEFAULT_FREQ * \
								   ((_channel)-IEEE_MIN_CHANNEL)))
/* Frequency calculation for a given channel. */
#define CHAN_TO_FREQ(_channel) (2400 + _channel)

/* Buffer for the radio TX packet */
static uint8_t tx_packet[RADIO_MAX_PAYLOAD_LEN];
/* Buffer for the radio RX packet. */
static uint8_t rx_packet[RADIO_MAX_PAYLOAD_LEN];
/* Number of transmitted packets. */
static uint32_t tx_packet_cnt;
/* Number of received packets with valid CRC. */
static uint32_t rx_packet_cnt;
/* Most recent measured RSSI value */
static uint8_t rssi;

/* Radio current channel (frequency). */
static uint8_t current_channel;

/* Timer used for channel sweeps and tx with duty cycle. */
static const nrfx_timer_t timer = NRFX_TIMER_INSTANCE(RADIO_TEST_TIMER_INSTANCE);

/* Total payload size */
static uint16_t total_payload_size;

/* PPI channel for starting radio */
static uint8_t ppi_radio_start;

static void radio_power_set(nrf_radio_mode_t mode, uint8_t channel, int8_t power)
{
	int8_t output_power = power;
	int8_t radio_power = power;

	ARG_UNUSED(mode);
	ARG_UNUSED(channel);

	nrf_radio_txpower_set(NRF_RADIO, (nrf_radio_txpower_t)radio_power);
}

static void radio_ppi_tx_reconfigure(void)
{
	nrfx_gppi_channels_disable(BIT(ppi_radio_start));
	nrfx_gppi_fork_endpoint_clear(ppi_radio_start,
								  nrf_timer_task_address_get(timer.p_reg, NRF_TIMER_TASK_START));
	nrfx_gppi_event_endpoint_clear(ppi_radio_start,
								   nrf_egu_event_address_get(RADIO_TEST_EGU, RADIO_TEST_EGU_EVENT));
	nrfx_gppi_event_endpoint_setup(ppi_radio_start,
								   nrf_timer_event_address_get(timer.p_reg, NRF_TIMER_EVENT_COMPARE1));
	nrfx_gppi_channels_enable(BIT(ppi_radio_start));
}

// static void radio_start(bool rx, bool force_egu)
// {
// 	if (IS_ENABLED(CONFIG_FEM) || force_egu)
// 	{
// 		nrf_egu_task_trigger(RADIO_TEST_EGU,
// 							 nrf_egu_task_address_get(RADIO_TEST_EGU, RADIO_TEST_EGU_TASK));
// 	}
// 	else
// 	{
// 		nrf_radio_task_trigger(NRF_RADIO, rx ? NRF_RADIO_TASK_RXEN : NRF_RADIO_TASK_TXEN);
// 	}
// }

static void radio_channel_set(nrf_radio_mode_t mode, uint8_t channel)
{
	uint16_t frequency;

	frequency = CHAN_TO_FREQ(channel);
	nrf_radio_frequency_set(NRF_RADIO, frequency);
}

static void radio_config(nrf_radio_mode_t mode, enum transmit_pattern pattern)
{
	nrf_radio_packet_conf_t packet_conf;

	/* Set fast ramp-up time. */
	nrf_radio_modecnf0_set(NRF_RADIO, true, RADIO_MODECNF0_DTX_Center);
	/* Disable CRC. */
	nrf_radio_crc_configure(NRF_RADIO, RADIO_CRCCNF_LEN_Disabled,
							NRF_RADIO_CRC_ADDR_INCLUDE, 0);

	/* Set the device address 0 to use when transmitting. */
	nrf_radio_txaddress_set(NRF_RADIO, 0);
	/* Enable the device address 0 to use to select which addresses to
	 * receive
	 */
	nrf_radio_rxaddresses_set(NRF_RADIO, 1);
	nrf_radio_prefix0_set(NRF_RADIO, 0x6A);
	nrf_radio_base0_set(NRF_RADIO, 0x58FE811B);

	/* Packet configuration:
	 * payload length size = 8 bits,
	 * 0-byte static length, max 255-byte payload,
	 * 4-byte base address length (5-byte full address length),
	 * Bit 24: 1 Big endian,
	 * Bit 25: 1 Whitening enabled.
	 */
	memset(&packet_conf, 0, sizeof(packet_conf));
	packet_conf.lflen = RADIO_LENGTH_LENGTH_FIELD;
	packet_conf.maxlen = (sizeof(tx_packet) - 1);
	packet_conf.statlen = 0;
	packet_conf.balen = 4;
	packet_conf.big_endian = true;
	packet_conf.whiteen = true;

	/* Packet configuration:
	 * S1 size = 0 bits,
	 * S0 size = 0 bytes,
	 * 10 bytes preamble.
	 */
	packet_conf.plen = NRF_RADIO_PREAMBLE_LENGTH_LONG_RANGE;
	packet_conf.cilen = 2;
	packet_conf.termlen = 3;
	packet_conf.big_endian = false;
	packet_conf.balen = 3;

	/* Set CRC length; CRC calculation does not include the address
	 * field.
	 */
	nrf_radio_crc_configure(NRF_RADIO, RADIO_CRCCNF_LEN_Three,
							NRF_RADIO_CRC_ADDR_SKIP, 0);

	/* preamble, address (BALEN + PREFIX), lflen, code indicator, TERM, payload, CRC */
	total_payload_size = 10 + (packet_conf.balen + 1) + 1 + packet_conf.cilen +
						 packet_conf.termlen + packet_conf.maxlen + RADIO_CRCCNF_LEN_Three;

	nrf_radio_packet_configure(NRF_RADIO, &packet_conf);
}

// static void generate_modulated_rf_packet(uint8_t mode,
// 										 enum transmit_pattern pattern)
// {
// 	radio_config(mode, pattern);
// 	tx_packet[0] = sizeof(tx_packet) - 1;
// 	memset(tx_packet + 1, 0xF0, sizeof(tx_packet) - 1);
// 	nrf_radio_packetptr_set(NRF_RADIO, tx_packet);
// }

static void radio_disable(void)
{
	nrf_radio_shorts_set(NRF_RADIO, 0);
	nrf_radio_int_disable(NRF_RADIO, ~0);
	nrf_radio_event_clear(NRF_RADIO, NRF_RADIO_EVENT_DISABLED);

	nrf_radio_task_trigger(NRF_RADIO, NRF_RADIO_TASK_DISABLE);
	while (!nrf_radio_event_check(NRF_RADIO, NRF_RADIO_EVENT_DISABLED))
	{
		/* Do nothing */
	}
	nrf_radio_event_clear(NRF_RADIO, NRF_RADIO_EVENT_DISABLED);
}

static void radio_mode_set(NRF_RADIO_Type *reg, nrf_radio_mode_t mode)
{

	nrf_radio_mode_set(reg, mode);
}

static void radio_modulated_tx_carrier(uint8_t mode, int8_t txpower, uint8_t channel,
									   enum transmit_pattern pattern)
{
	radio_disable();
	radio_config(mode, pattern);
	tx_packet[0] = sizeof(tx_packet) - 1;
	memset(tx_packet + 1, 0xF0, sizeof(tx_packet) - 1);
	nrf_radio_packetptr_set(NRF_RADIO, tx_packet);

	nrf_radio_shorts_enable(NRF_RADIO,
							NRF_RADIO_SHORT_READY_START_MASK |
								NRF_RADIO_SHORT_PHYEND_START_MASK);

	radio_mode_set(NRF_RADIO, mode);
	radio_power_set(mode, channel, txpower);

	radio_channel_set(mode, channel);

	tx_packet_cnt = 0;

	nrf_radio_event_clear(NRF_RADIO, NRF_RADIO_EVENT_END);
	nrf_radio_int_enable(NRF_RADIO, NRF_RADIO_INT_END_MASK);

	nrf_radio_task_trigger(NRF_RADIO, NRF_RADIO_TASK_TXEN);
}

static void radio_rx(uint8_t mode, uint8_t channel, enum transmit_pattern pattern)
{
	radio_disable();

	radio_mode_set(NRF_RADIO, mode);
	nrf_radio_shorts_enable(NRF_RADIO,
							NRF_RADIO_SHORT_READY_START_MASK |
								NRF_RADIO_SHORT_END_START_MASK |
								NRF_RADIO_SHORT_ADDRESS_RSSISTART_MASK |
								NRF_RADIO_SHORT_DISABLED_RSSISTOP_MASK);
	nrf_radio_packetptr_set(NRF_RADIO, rx_packet);

	radio_config(mode, pattern);
	radio_channel_set(mode, channel);

	rx_packet_cnt = 0;

	nrf_radio_int_enable(NRF_RADIO, NRF_RADIO_INT_CRCOK_MASK | NRF_RADIO_INT_RSSIEND_MASK);

	nrf_radio_task_trigger(NRF_RADIO, NRF_RADIO_TASK_RXEN);
}

void radio_test_start(const struct radio_test_config *config)
{

	switch (config->type)
	{
	case MODULATED_TX:
		radio_modulated_tx_carrier(config->mode,
								   config->params.modulated_tx.txpower,
								   config->params.modulated_tx.channel,
								   config->params.modulated_tx.pattern);
		break;
	case RX:
		radio_rx(config->mode,
				 config->params.rx.channel,
				 config->params.rx.pattern);
		break;
	}
}

void radio_test_cancel(void)
{
	nrfx_timer_disable(&timer);
	nrfx_timer_clear(&timer);

	// sweep_processing = false;

	nrfx_gppi_channels_disable(BIT(ppi_radio_start));
	nrfx_gppi_event_endpoint_clear(ppi_radio_start,
								   nrf_egu_event_address_get(RADIO_TEST_EGU, RADIO_TEST_EGU_EVENT));
	nrfx_gppi_task_endpoint_clear(ppi_radio_start,
								  nrf_radio_task_address_get(NRF_RADIO, NRF_RADIO_TASK_TXEN));
	nrfx_gppi_task_endpoint_clear(ppi_radio_start,
								  nrf_radio_task_address_get(NRF_RADIO, NRF_RADIO_TASK_RXEN));
	nrfx_gppi_fork_endpoint_clear(ppi_radio_start,
								  nrf_timer_task_address_get(timer.p_reg, NRF_TIMER_TASK_START));
	nrfx_gppi_event_endpoint_clear(ppi_radio_start,
								   nrf_timer_event_address_get(timer.p_reg, NRF_TIMER_EVENT_COMPARE1));

	radio_disable();
}

void radio_rx_stats_get(struct radio_rx_stats *rx_stats)
{
	size_t size;
	size = sizeof(rx_packet);
	rx_stats->last_packet.buf = rx_packet;
	rx_stats->last_packet.len = size;
	rx_stats->packet_cnt = rx_packet_cnt;
}

void radio_handler(const void *context)
{
	if (nrf_radio_event_check(NRF_RADIO, NRF_RADIO_EVENT_CRCOK))
	{
		nrf_radio_event_clear(NRF_RADIO, NRF_RADIO_EVENT_CRCOK);
		rx_packet_cnt++;

		nrf_radio_task_trigger(NRF_RADIO, NRF_RADIO_TASK_RSSISTOP);
	}

	if (nrf_radio_event_check(NRF_RADIO, NRF_RADIO_EVENT_RSSIEND))
	{
		rssi = nrf_radio_rssi_sample_get(NRF_RADIO);
	}

	if (nrf_radio_event_check(NRF_RADIO, NRF_RADIO_EVENT_END))
	{
		nrf_radio_event_clear(NRF_RADIO, NRF_RADIO_EVENT_END);

		tx_packet_cnt++;
	}
}

int radio_test_init(struct radio_test_config *config)
{
	// Radio handler only counts sent/received packets
	irq_connect_dynamic(RADIO_IRQn, IRQ_PRIO_LOWEST, radio_handler, config, 0);
	irq_enable(RADIO_IRQn);

	return 0;
}
```

## src/service.h
```c
#ifndef SERVICE_H_
#define SERVICE_H_

#include <zephyr/bluetooth/bluetooth.h>
#include <zephyr/bluetooth/hci.h>
#include <zephyr/bluetooth/conn.h>
#include <zephyr/bluetooth/addr.h>
#include <zephyr/bluetooth/uuid.h>
#include <zephyr/bluetooth/gatt.h>

typedef enum
{
    SET_TX_MODE = 0x00,
    SET_TX_POWER = 0x01,
    SET_TX_CHANNEL = 0x02,
    SET_PACKET_SIZE = 0x03,

    START_TX = 0x10,
    START_RX = 0x11,
} command_t;

extern bool indicate_active;
int send_all_logs(void);

int host_service_init(void);

#endif
```
